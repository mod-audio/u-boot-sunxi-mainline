## configs/Itead_CoreEVB_A20_defconfig
```kconfig
CONFIG_ARM=y
CONFIG_ARCH_SUNXI=y
CONFIG_MACH_SUN7I=y
CONFIG_DEFAULT_DEVICE_TREE="sun7i-a20-iteadCoreEVB"
CONFIG_SPL=y
CONFIG_SPL_I2C_SUPPORT=y
CONFIG_SPL_TEXT_BASE=0x60

## --- WmT, testing: CONFIG_DRAM_CLK
## Assume defaults are failsafe. Marsboard had:
CONFIG_DRAM_CLK=432
##	CONFIG_DRAM_ZQ=123
##	CONFIG_DRAM_TIMINGS_DDR3_800E_1066G_1333J=y
CONFIG_NR_DRAM_BANKS=1
## ---

## --- WmT, testing: CONFIG_MMC0_CD_PIN
##	...empty implies card detection is disabled
##	...Marsboard_A20 was broken? Same not assumed here
CONFIG_MMC0_CD_PIN="PH1"
#|CONFIG_MMC0_CD_PIN=""
#|#|CONFIG_MMC_SUNXI_SLOT_EXTRA=2
## ---

CONFIG_USB0_VBUS_PIN="PH17"
CONFIG_USB0_VBUS_DET="PH22"
CONFIG_USB0_ID_DET="PH19"

## --- WmT, 2019-03-12: old kernel support
## About CONFIG_OLD_SUNXI_KERNEL_COMPAT
##	...related to supervisor (SVC) vs hypervisor (HYP) mode?
##	..._NONSEC && !_BOOT_SEC_DEFAULT -> hypervisor mode ("nonsec")
## U-Boot PSCI interface requires "nonsec" (HYP) mode;
##	...U-Boot will automatically provide PSCI device nodes
## Where kernels don't support non-secure mode, set bootm_boot_mode=sec
CONFIG_OLD_SUNXI_KERNEL_COMPAT=y
CONFIG_ARMV7_NONSEC=y
CONFIG_ARMV7_BOOT_SEC_DEFAULT=y
## ---

## --- WmT, 2019-03-14: Ethernet support
## CONFIG_NET is on by default normally
##	...and for sunxi needs patching to turn off
##	EMAC overkill? (Useful only for Marsboard?)
## Possible (but non-obvious) benefit from further options:
##	CONFIG_SUN7I_GMAC_FORCE_TXERR=y
##	CONFIG_PHY_FIXED=y
CONFIG_GMAC_TX_DELAY=1

CONFIG_NET=y
CONFIG_ETH_DESIGNWARE=y
CONFIG_MII=y
CONFIG_RGMII=y
CONFIG_SUN4I_EMAC=y
CONFIG_SUN7I_GMAC=y
##CONFIG_SUN7I_GMAC_FORCE_TXERR=y
##CONFIG_PHY_FIXED=y
##CONFIG_GMAC_TX_DELAY defaults to 0

CONFIG_VIDEO_VGA=y
CONFIG_SATAPWR="PH12"
CONFIG_AHCI=y
CONFIG_CMD_DFU=y
CONFIG_CMD_USB_MASS_STORAGE=y
CONFIG_SCSI_AHCI=y
CONFIG_SCSI=y
CONFIG_USB_EHCI_HCD=y
CONFIG_USB_OHCI_HCD=y
CONFIG_USB_MUSB_GADGET=y
CONFIG_SYS_USB_EVENT_POLL_VIA_INT_QUEUE=y
CONFIG_DFU_RAM=y
CONFIG_FASTBOOT_CMD_OEM_FORMAT=y
```

## configs/Marsboard_A20_defconfig
```kconfig
CONFIG_ARM=y
CONFIG_ARCH_SUNXI=y
CONFIG_MACH_SUN7I=y
CONFIG_DEFAULT_DEVICE_TREE="sun7i-a20-marsboard"
CONFIG_SPL=y
CONFIG_SPL_I2C_SUPPORT=y
CONFIG_SPL_TEXT_BASE=0x60

## --- WmT, testing: CONFIG_DRAM_CLK
## Failsafe DRAM settings (also applicable to SPL)
##	+S:CONFIG_DRAM_CLK=360
##	+S:CONFIG_DRAM_ZQ=123
##	+S:CONFIG_DRAM_EMR1=4
##	+S:CONFIG_DRAM_TIMINGS_DDR3_800E_1066G_1333J=y
## ...Cubieboard ends up with CONFIG_DRAM_CLK=480
CONFIG_DRAM_CLK=360
CONFIG_DRAM_ZQ=123
CONFIG_DRAM_TIMINGS_DDR3_800E_1066G_1333J=y
CONFIG_NR_DRAM_BANKS=1
## ---

## --- WmT, testing: CONFIG_MMC0_CD_PIN
##	...empty implies card detection is disabled
##	...is set in Cubieboard2 DT (but "no card present" if used)
##	...set in DT for Marsboard_A10 (but not desirable?)
##CONFIG_MMC0_CD_PIN="PH1"
CONFIG_MMC0_CD_PIN=""
##CONFIG_MMC_SUNXI_SLOT_EXTRA=2
## ---
## --- WmT, 2019-03-12: old kernel support
## About CONFIG_OLD_SUNXI_KERNEL_COMPAT
##	...related to supervisor (SVC) vs hypervisor (HYP) mode?
##	..._NONSEC && !_BOOT_SEC_DEFAULT -> hypervisor mode ("nonsec")
## U-Boot PSCI interface requires "nonsec" (HYP) mode;
##	...U-Boot will automatically provide PSCI device nodes
## For legacy kernels, non-secure mode is not supported;
##	...ensure `setenv bootm_boot_mode=sec`
##	...ensure script_parser_fetch() requirements are met (boot.scr?)
CONFIG_OLD_SUNXI_KERNEL_COMPAT=y
CONFIG_ARMV7_NONSEC=y
CONFIG_ARMV7_BOOT_SEC_DEFAULT=n
CONFIG_ARMV7_LPAE=n
## ---

## --- WmT, 2019-03-14: Ethernet support
## CONFIG_NET is on by default
##	...and for sunxi needs patching to turn off
## Possible (but non-obvious) benefit from further options:
##	CONFIG_SUN7I_GMAC_FORCE_TXERR=y
##	CONFIG_PHY_FIXED=y
CONFIG_NET=y
CONFIG_ETH_DESIGNWARE=y
CONFIG_MII=y
CONFIG_SUN4I_EMAC=y
CONFIG_SUN7I_GMAC=y
##CONFIG_SUN7I_GMAC_FORCE_TXERR=y
##CONFIG_PHY_FIXED=y
##CONFIG_GMAC_TX_DELAY defaults to 0
## ---

## --- WmT, 2019-05-28: USB support
## OHCI/UHCI for USB1.1, EHCI for USB to 2.0, XHCI for USB to 3.0
## NB. Device tree includes &ehci{0|1} and &ohci{0|1}
## CONFIG_USB_KEYBOARD=y should be enabled by default
## U-Boot is too big if all these are enabled?
#CONFIG_USB_XHCI_HCD=y
CONFIG_USB_EHCI_HCD=y
#CONFIG_USB_OHCI_HCD=y
#CONFIG_USB_UHCI_HCD=y
## ---

### --- WmT, 2019-05-29: NAND support
CONFIG_NAND=y
## CONFIG_NAND_SUNXI becomes enabled by default
## "Micron MT29F64G08CBABAWP" (dmesg) -> `mtdinfo -a` report:
##| Eraseblock size:                2097152 bytes, 2.0 MiB
##| Sub-page size:                  8192 bytes
##| OOB size:                       744 bytes
CONFIG_SYS_NAND_BLOCK_SIZE=2097152
CONFIG_SYS_NAND_PAGE_SIZE=8192
CONFIG_SYS_NAND_OOBSIZE=744
CONFIG_CMD_NAND=y
CONFIG_CMD_MTDPARTS=y
## About devices and partition scheme:
## - Smallest permissible division matches the 2MiB block size
## - 2G "max" size needed to avoid issues initialising larger partitions
CONFIG_MTD=y
CONFIG_MTDIDS_DEFAULT="nand0=mlc0"
##CONFIG_MTDPARTS_DEFAULT="mtdparts=mlc0:4G(reserved)ro,-(mlcnand1)"
##CONFIG_MTDPARTS_DEFAULT="mtdparts=mlc0:4G(reserved)ro,1G(mlcnand1),-(mlcnand2)"
CONFIG_MTDPARTS_DEFAULT="mtdparts=mlc0:32M(boot)ro,-(ubi)"
### ---

### --- WmT, 2019-06-17: boot config
# CONFIG_ENV_IS_IN_FAT is not set
CONFIG_ENV_IS_IN_UBI=y
##| CONFIG_ENV_UBI_PART=""
CONFIG_ENV_UBI_PART="ubi"
##| CONFIG_ENV_UBI_VOLUME=""
CONFIG_ENV_UBI_VOLUME="env"
## also CONFIG_ENV_UBI_VOLUME_REDUND?
### ---
```
